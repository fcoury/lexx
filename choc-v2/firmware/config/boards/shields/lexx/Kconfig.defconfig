## choc-v2/firmware/config/boards/shields/lexx/Kconfig.defconfig
```kconfig
if SHIELD_LEXX_LEFT || SHIELD_LEXX_RIGHT

config ZMK_KEYBOARD_NAME
    default "Lexx Choc V2"

config ZMK_SPLIT
    default y

endif

if SHIELD_LEXX_LEFT

config ZMK_SPLIT_ROLE_CENTRAL
    default y

endif
```

## pcb/firmware/config/boards/shields/lexx/Kconfig.shield
```kconfig
config SHIELD_LEXX_LEFT
    def_bool $(shields_list_contains,lexx_left)

config SHIELD_LEXX_RIGHT
    def_bool $(shields_list_contains,lexx_right)
```
